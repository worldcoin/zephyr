## drivers/sensor/st/vl53l1x/Kconfig
```kconfig
# VL53L0X time of flight sensor configuration options

# Copyright (c) 2023 Prosaris Solutions Inc.
# SPDX-License-Identifier: Apache-2.0

menuconfig VL53L1X
	bool "VL53L1X time of flight sensor"
	default y
	depends on DT_HAS_ST_VL53L1X_ENABLED
	depends on ZEPHYR_HAL_ST_MODULE
	select I2C
	select HAS_STLIB
	help
	  Enable driver for VL53L1X I2C-based time of flight sensor.

if VL53L1X

config VL53L1X_INTERRUPT_MODE
	bool "Use interrupt mode for VL53L1X time of flight sensor"
	default y
	depends on GPIO
	help
	  Enable interrupt mode for VL53L1X time of flight sensor. Otherwise,
	  the driver will use the polling method.

config VL53L1X_XSHUT
	bool "Use xshut pin on VL53L1X time of flight sensor"
	depends on GPIO
	help
	  Enable to use the xshut pin on the VL53L1X. If not, the pin should be
	  connected to VDD.

config VL53L1X_PROXIMITY_THRESHOLD
    int "Proximity threshold in millimeters"
    default 100
    help
        Threshold used for proximity detection when sensor is used with SENSOR_CHAN_PROX.

config VL53L1X_SIGNAL_SPAD_RATIO_THRESHOLD
	int "Signal SPAD ratio threshold"
	default 300
	help
	  The signal to SPAD-count ratio is used for proximity detection when sensor is used with SENSOR_CHAN_PROX.
	  It helps remove false positives when the sensor is used in a dark environment and spits out phantom readings.
	  The ratio is calculated as follows:
	  	ratio = (Signal rate / SPAD count) * 1000

endif # VL53L1X
```
